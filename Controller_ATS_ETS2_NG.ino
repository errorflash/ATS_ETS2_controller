#include <Keyboard.h>
#include <Wire.h>
#include <LiquidCrystal_I2C.h>

//-----debounce----
const uint32_t debounce1 = 200;
const uint32_t debounce2 = 600;

//-----switches-----
uint32_t jetzt_shiftl = millis(); //shifter forward
uint32_t jetzt_strgl = millis(); //shifter reverse
uint32_t jetzt_q = millis(); //shifter neutral
uint32_t jetzt_p = millis(); //wiper up
uint32_t jetzt_f = millis(); //hazard
uint32_t jetzt_v1 = millis(); //difflock on
uint32_t jetzt_v2 = millis(); //difflock off
uint32_t jetzt_m = millis(); //map
uint32_t jetzt_enter = millis(); //activate
uint32_t jetzt_t = millis(); //pullon/off
uint32_t jetzt_space1 = millis(); //handbrake tight
uint32_t jetzt_space2 = millis(); //handbrake lose
uint32_t jetzt_2 = millis(); //outside look
uint32_t jetzt_1 = millis(); //inside look
uint32_t jetzt_x = millis(); //wiper down
uint32_t jetzt_c = millis(); //tempomat
uint32_t jetzt_o1 = millis(); //orange light beacons on
uint32_t jetzt_o2 = millis(); //orange light beacons off
uint32_t jetzt_z0 = millis(); //motor off
uint32_t jetzt_z1 = millis(); //ignition
uint32_t jetzt_z2 = millis(); //motor start
uint32_t jetzt_j = millis(); //highbeam flash
uint32_t jetzt_k = millis(); //highbeam
uint32_t jetzt_esc = millis(); //menu
uint32_t jetzt_F1 = millis(); //pause
uint32_t jetzt_n = millis(); //airhorn
uint32_t jetzt_l0 = millis(); //licht aus
uint32_t jetzt_l1 = millis(); //standlicht
uint32_t jetzt_l2 = millis(); //abblendlicht
uint32_t jetzt_F10 = millis(); //lookright
uint32_t jetzt_F9 = millis(); //lookleft
uint32_t jetzt_lc = millis(); //lookcenter
uint32_t jetzt_i = millis(); //bordcomputer
uint32_t jetzt_fuel = millis(); //fuelfill
uint32_t jetzt_bb = millis(); //blue button
uint32_t jetzt_gb = millis(); //green button
uint32_t jetzt_blk = millis();  //black button
uint32_t jetzt_rb = millis(); //red button
uint32_t jetzt_yb = millis(); //yellow button

//-----Cruise Control-----
int encoderPinA = 34;
int encoderPinB = 35;
int encoderPos = 0;
int encoderPinALast = LOW;
int encoderPinANow = LOW;

//-----Retarder-----
int encoderPinC = 36;
int encoderPinD = 37;
int encoderPinCLast = LOW;
int encoderPinCNow = LOW;

//-----Radio Select-----
int encoderPinE = 12;
int encoderPinF = 13;
int encoderPinELast = LOW;
int encoderPinENow = LOW;

//-------light----------
int xx = 0;

//--------lcd / poti radio--------
LiquidCrystal_I2C lcd(0x27,16,2);

int pot1 = A2; 
int pot1_wert = 0;
int oldpot1_wert = 0; 

void setup() {
  
  pinMode(0, INPUT_PULLUP);   //forward shift l
  pinMode(1, INPUT_PULLUP);   //reverse strg l
  pinMode(2, INPUT_PULLUP);   //hazard f
  pinMode(3, INPUT_PULLUP);   //wiper up p
  pinMode(4, INPUT_PULLUP);   //difflock v
  pinMode(5, INPUT_PULLUP);   //map m
  pinMode(6, INPUT_PULLUP);   //activate enter
  pinMode(7, INPUT_PULLUP);   //pullon/off t
  pinMode(8, INPUT_PULLUP);   //handbrake space
  pinMode(9, INPUT_PULLUP);   //outside look 2
  pinMode(10, INPUT_PULLUP);  //inside look 1
  pinMode(14, INPUT_PULLUP);  //wiper down x
  pinMode(15, INPUT_PULLUP);  //cruisecontrol c
  pinMode(16, INPUT_PULLUP);  //beacons o
  pinMode(18, INPUT_PULLUP);  //ingnition z
  pinMode(19, INPUT_PULLUP);  //motor start e
  pinMode(22, INPUT_PULLUP);  //look right F
  pinMode(23, INPUT_PULLUP);  //look center 1
  pinMode(24, INPUT_PULLUP);  //look left F
  pinMode(25, INPUT_PULLUP);  //airhorn n
  pinMode(26, INPUT_PULLUP);  //highbeam flash j
  pinMode(27, INPUT_PULLUP);  //highbeam k
  pinMode(28, INPUT_PULLUP);  //menu esc (177)
  pinMode(29, INPUT_PULLUP);  //pause F1 (195)
  pinMode(30, INPUT_PULLUP);  //lights off
  pinMode(31, INPUT_PULLUP);  //headlights
  pinMode(32, INPUT_PULLUP);  //boardcomputer i
  pinMode(33, INPUT_PULLUP);  //fuel fill enter
  pinMode(40, INPUT_PULLUP);  //blue button
  pinMode(42, INPUT_PULLUP);  //green button
  pinMode(43, INPUT_PULLUP);  //red button
  pinMode(39, INPUT_PULLUP);  //black button
  pinMode(38, INPUT_PULLUP);  //yellow button
  
  
  pinMode (encoderPinA, INPUT_PULLUP);
  pinMode (encoderPinB, INPUT_PULLUP);
  pinMode (encoderPinC, INPUT_PULLUP);
  pinMode (encoderPinD, INPUT_PULLUP);
  pinMode (encoderPinE, INPUT_PULLUP);
  pinMode (encoderPinF, INPUT_PULLUP);
  
  lcd.init();              
  lcd.setCursor(1,0);
  lcd.print("Volume");
  lcd.backlight();
  
  Keyboard.begin();
   
}

void loop() {
  
  jetzt_shiftl = millis();  //forward
  jetzt_strgl = millis(); //reverse
  jetzt_q = millis(); //netral
  jetzt_f = millis(); //wiper up
  jetzt_p = millis(); //hazard
  jetzt_v1 = millis();  //difflock on
  jetzt_v2 = millis();  //difflock off
  jetzt_m = millis(); //map
  jetzt_enter = millis(); //activate
  jetzt_t = millis(); //pull on/off
  jetzt_space1 = millis();  //handbrake on
  jetzt_space2 = millis();  //handbrake off
  jetzt_2 = millis(); //outside
  jetzt_1 = millis(); //inside
  jetzt_x = millis(); //wiper down
  jetzt_c = millis(); //cruise control c
  jetzt_o1 = millis(); //beacons on
  jetzt_o2 = millis(); //beacons off
  jetzt_z0 = millis(); //motor off
  jetzt_z1 = millis(); //ignition
  jetzt_z2 = millis(); //motor start
  jetzt_n = millis(); //airhorn
  jetzt_j = millis(); //flash highbeam
  jetzt_k = millis(); //highbeam
  jetzt_esc = millis(); //menu
  jetzt_F1 = millis(); //pause
  jetzt_l0 = millis(); //licht aus
  jetzt_l1 = millis(); //standlicht
  jetzt_l2 = millis(); //abblendlicht
  jetzt_F10 = millis(); //lookright
  jetzt_F9 = millis(); //lookleft
  jetzt_lc = millis(); //lookcenter
  jetzt_i = millis(); //bordcomputer
  jetzt_bb = millis();  //blue button
  jetzt_gb = millis();  //green button
  jetzt_blk = millis();  //black button
  jetzt_rb = millis(); //red button
  jetzt_yb = millis(); //yellow button
 
//-------------D / R / N----------------------
  
  static uint32_t vorhin_shiftl = jetzt_shiftl;
  static bool einmal_shiftl = false;
  bool neu_shiftl = !digitalRead(0);
  static bool alt_shiftl = neu_shiftl;
  if (neu_shiftl && !alt_shiftl && !einmal_shiftl) {
    vorhin_shiftl = jetzt_shiftl;
    einmal_shiftl = true;
    Keyboard.press(129);
    delay(90);
    Keyboard.release(129);
  }
  if (einmal_shiftl && (jetzt_shiftl - vorhin_shiftl >= debounce1)) {
    einmal_shiftl = false;
  }
  alt_shiftl = neu_shiftl;
  
  
  static uint32_t vorhin_strgl = jetzt_strgl;
  static bool einmal_strgl = false;
  bool neu_strgl = !digitalRead(1);
  static bool alt_strgl = neu_strgl;
  if (neu_strgl && !alt_strgl && !einmal_strgl) {
    vorhin_strgl = jetzt_shiftl;
    einmal_strgl = true;
    Keyboard.press(128);
    delay(90);
    Keyboard.release(128);
  }
  if (einmal_strgl && (jetzt_strgl - vorhin_strgl >= debounce1)) {
    einmal_strgl = false;
  }
  alt_strgl = neu_strgl;
  
  static uint32_t vorhin_q = jetzt_q;
  static bool einmal_q = false;
  bool neu_q = (digitalRead(0) == HIGH && digitalRead(1) == HIGH);
  static bool alt_q = neu_q;
  if (neu_q && !alt_q && !einmal_q) {
    vorhin_q = jetzt_q;
    einmal_q = true;
    Keyboard.press('q');
    delay(90);
    Keyboard.release('q');
  }
  if (einmal_q && (jetzt_q - vorhin_q >= debounce1)) {
    einmal_q = false;
  }
  alt_q = neu_q;

//--------------hazard-----------------------------

  static uint32_t vorhin_f = jetzt_f;
  static bool einmal_f = false;
  bool neu_f = !digitalRead(2);
  static bool alt_f = neu_f;
  if (neu_f && !alt_f && !einmal_f) {
    vorhin_f = jetzt_f;
    einmal_f = true;
    Keyboard.press('f');
    delay(90);
    Keyboard.release('f');
  }
  if (einmal_f && (jetzt_f - vorhin_f >= debounce1)) {
    einmal_f = false;
  }
  alt_f = neu_f;

//--------------------wiper--------------------------

  static uint32_t vorhin_p = jetzt_p;
  static bool einmal_p = false;
  bool neu_p = !digitalRead(3);
  static bool alt_p = neu_p;
  if (neu_p && !alt_p && !einmal_p) {
    vorhin_p = jetzt_p;
    einmal_p = true;
    Keyboard.press('p');
    delay(90);
    Keyboard.release('p');
  }
  if (einmal_p && (jetzt_p - vorhin_p >= debounce1)) {
    einmal_p = false;
  }
  alt_p = neu_p;
       
//--------------------difflock--------------------------
     
  static uint32_t vorhin_v1 = jetzt_v1;
  static bool einmal_v1 = false;
  bool neu_v1 = !digitalRead(4);
  static bool alt_v1 = neu_v1;
  if (neu_v1 && !alt_v1 && !einmal_v1) {
    vorhin_v1 = jetzt_v1;
    einmal_v1 = true;
    Keyboard.press('v');
    delay(90);
    Keyboard.release('v');
  }
  if (einmal_v1 && (jetzt_v1 - vorhin_v1 >= debounce1)) {
    einmal_v1 = false; 
  }
  alt_v1 = neu_v1;

  static uint32_t vorhin_v2 = jetzt_v2;
  static bool einmal_v2 = false;
  bool neu_v2 = !digitalRead(4)== LOW;
  static bool alt_v2 = neu_v2;
  if (neu_v2 && !alt_v2 && !einmal_v2) {
    vorhin_v2 = jetzt_v2;
    einmal_v2 = true;
    Keyboard.press('v');
    delay(90);
    Keyboard.release('v');
  }
  if (einmal_v2 && (jetzt_v2 - vorhin_v2 >= debounce1)) {
    einmal_v2 = false; 
  }
  alt_v2 = neu_v2;
  
  
//--------------------map--------------------------
   
  static uint32_t vorhin_m = jetzt_m;
  static bool einmal_m = false;
  bool neu_m = !digitalRead(5);
  static bool alt_m = neu_m;
  if (neu_m && !alt_m && !einmal_m) {
    vorhin_m = jetzt_m;
    einmal_m = true;
    Keyboard.press('m');
    delay(90);
    Keyboard.release('m');
  }
  if (einmal_m && (jetzt_m - vorhin_m >= debounce1)) {
    einmal_m = false;
  }
  alt_m = neu_m;
  
//--------------------activate--------------------------
  
  static uint32_t vorhin_enter = jetzt_enter;
  static bool einmal_enter = false;
  bool neu_enter = !digitalRead(6);
  static bool alt_enter = neu_enter;
  if (neu_enter && !alt_enter && !einmal_enter) {
    vorhin_enter = jetzt_enter;
    einmal_enter = true;
    Keyboard.press(176);
    delay(90);
    Keyboard.release(176);
  }
  if (einmal_enter && (jetzt_enter - vorhin_enter >= debounce1)) {
    einmal_enter = false;
  }
  alt_enter = neu_enter;
  
//--------------------pull on / off--------------------------
    
  static uint32_t vorhin_t = jetzt_t;
  static bool einmal_t = false;
  bool neu_t = !digitalRead(7);
  static bool alt_t = neu_t;
  if (neu_t && !alt_t && !einmal_t) {
    vorhin_t = jetzt_t;
    einmal_t = true;
    Keyboard.press('t');
    delay(90);
    Keyboard.release('t');
  }
  if (einmal_t && (jetzt_t - vorhin_t >= debounce1)) {
    einmal_t = false;
  }
  alt_t = neu_t;
    
//--------------------handbrake--------------------------
  
  static uint32_t vorhin_space1 = jetzt_space1;
  static bool einmal_space1 = false;
  bool neu_space1 = !digitalRead(8);
  static bool alt_space1 = neu_space1;
  if (neu_space1 && !alt_space1 && !einmal_space1) {
    vorhin_space1 = jetzt_space1;
    einmal_space1  = true;
    Keyboard.press(32);
    delay(90);
    Keyboard.release(32);
  }
  if (einmal_space1 && (jetzt_space1 - vorhin_space1 >= debounce1)) {
    einmal_space1 = false;
  }
  alt_space1 = neu_space1;

   static uint32_t vorhin_space2 = jetzt_space2;
  static bool einmal_space2 = false;
  bool neu_space2 = !digitalRead(8) == LOW;
  static bool alt_space2 = neu_space2;
  if (neu_space2 && !alt_space2 && !einmal_space2) {
    vorhin_space2 = jetzt_space2;
    einmal_space2  = true;
    Keyboard.press(32);
    delay(90);
    Keyboard.release(32);
  }
  if (einmal_space2 && (jetzt_space2 - vorhin_space2 >= debounce1)) {
    einmal_space2 = false;
  }
  alt_space2 = neu_space2;
  
  
//--------------------outside look--------------------------
   
  static uint32_t vorhin_2 = jetzt_2;
  static bool einmal_2 = false;
  bool neu_2 = !digitalRead(9);
  static bool alt_2 = neu_2;
  if (neu_2 && !alt_2 && !einmal_2) {
    vorhin_2 = jetzt_2;
    einmal_2  = true;
    Keyboard.press('2');
    delay(90);
    Keyboard.release('2');
  }
  if (einmal_2 && (jetzt_2 - vorhin_2 >= debounce1)) {
    einmal_2 = false;
  }
  alt_2 = neu_2;
  
//--------------------inside look--------------------------
  
  static uint32_t vorhin_1 = jetzt_1;
  static bool einmal_1 = false;
  bool neu_1 = !digitalRead(10);
  static bool alt_1 = neu_1;
  if (neu_1 && !alt_1 && !einmal_1) {
    vorhin_1 = jetzt_1;
    einmal_1  = true;
    Keyboard.press('1');
    delay(90);
    Keyboard.release('1');
  }
  if (einmal_1 && (jetzt_1 - vorhin_1 >= debounce1)) {
    einmal_1 = false;
  }
  alt_1 = neu_1;
   
//--------------------wiper down--------------------------
  
  static uint32_t vorhin_x = jetzt_x;
  static bool einmal_x = false;
  bool neu_x = !digitalRead(14);
  static bool alt_x = neu_x;
  if (neu_x && !alt_x && !einmal_x) {
    vorhin_x = jetzt_x;
    einmal_x  = true;
    Keyboard.press('x');
    delay(90);
    Keyboard.release('x');
  }
  if (einmal_x && (jetzt_x - vorhin_x >= debounce1)) {
    einmal_x = false;
  }
  alt_x = neu_x;
   
//--------------------tempomat--------------------------
  
  static uint32_t vorhin_c = jetzt_c;
  static bool einmal_c = false;
  bool neu_c = !digitalRead(15);
  static bool alt_c = neu_c;
  if (neu_c && !alt_c && !einmal_c) {
    vorhin_c = jetzt_c;
    einmal_c  = true;
    Keyboard.press('c');
    delay(90);
    Keyboard.release('c');
  }
  if (einmal_c && (jetzt_c - vorhin_c >= debounce1)) {
    einmal_c = false;
  }
  alt_c = neu_c;
    
//--------------------orange light--------------------------
  
  static uint32_t vorhin_o1 = jetzt_o1;
  static bool einmal_o1 = false;
  bool neu_o1 = !digitalRead(16);
  static bool alt_o1 = neu_o1;
  if (neu_o1 && !alt_o1 && !einmal_o1) {
    vorhin_o1 = jetzt_o1;
    einmal_o1  = true;
    Keyboard.press('o');
    delay(90);
    Keyboard.release('o');
  }
  if (einmal_o1 && (jetzt_o1 - vorhin_o1 >= debounce1)) {
    einmal_o1 = false;
  }
  alt_o1 = neu_o1;

  static uint32_t vorhin_o2 = jetzt_o2;
  static bool einmal_o2 = false;
  bool neu_o2 = !digitalRead(16) == LOW;
  static bool alt_o2 = neu_o2;
  if (neu_o2 && !alt_o2 && !einmal_o2) {
    vorhin_o2 = jetzt_o2;
    einmal_o2  = true;
    Keyboard.press('o');
    delay(90);
    Keyboard.release('o');
  }
  if (einmal_o2 && (jetzt_o2 - vorhin_o2 >= debounce1)) {
    einmal_o2 = false;
  }
  alt_o2 = neu_o2;
   
//------------------ignition off--------------------------
  
  static uint32_t vorhin_z0 = jetzt_z0;
  static bool einmal_z0 = false;
  bool neu_z0 = (digitalRead(18) == HIGH && digitalRead(19) ==HIGH);
  static bool alt_z0 = neu_z0;
  if (neu_z0 && !alt_z0 && !einmal_z0) {
    vorhin_z0 = jetzt_z0;
    einmal_z0 = true;
    Keyboard.press('y');
    delay(120);
    Keyboard.release('y');
  }
  if (einmal_z0 && (jetzt_z0 - vorhin_z0 >= debounce2)) {
    einmal_z0 = false;
  }
  alt_z0 = neu_z0;
  
//--------------------ignition on--------------------------
  
  static uint32_t vorhin_z1 = jetzt_z1;
  static bool einmal_z1 = false;
  bool neu_z1 = !digitalRead(18);
  static bool alt_z1 = neu_z1;
  if (neu_z1 && !alt_z1 && !einmal_z1) {
    vorhin_z1 = jetzt_z1;
    einmal_z1  = true;
    Keyboard.press('y');
    delay(120);
    Keyboard.release('y');
  }
  if (einmal_z1 && (jetzt_z1 - vorhin_z1 >= debounce2)) {
    einmal_z1 = false;
  }
  alt_z1 = neu_z1;
   
//--------------------engine on--------------------------
   
  static uint32_t vorhin_z2 = jetzt_z2;
  static bool einmal_z2 = false;
  bool neu_z2 = !digitalRead(19);
  static bool alt_z2 = neu_z2;
  if (neu_z2 && !alt_z2 && !einmal_z2) {
    vorhin_z2 = jetzt_z2;
    einmal_z2  = true;
    Keyboard.press('e');
    delay(120);
    Keyboard.release('e');
  }
  if (einmal_z2 && (jetzt_z2 - vorhin_z2 >= debounce2)) {
    einmal_z2 = false;
  }
  alt_z2 = neu_z2;
    
//-----Tempomat +/- -----
   
  encoderPinANow = digitalRead(encoderPinA);
  if ((encoderPinALast == HIGH) && (encoderPinANow == LOW)) {
    if (digitalRead(encoderPinB) == HIGH) {
      //encoderPos++;
      Keyboard.press(0x5D);
      delay(150);
      Keyboard.release(0x5D);
    } else {
      //encoderPos--;
      Keyboard.press(0x2F);
      delay(150);
      Keyboard.release(0x2F);
      
    }
  }
  encoderPinALast = encoderPinANow;


//-----Airhorn-----

  //static uint32_t vorhin_n = jetzt_n;
  //static bool einmal_n = false;
  //bool neu_n = !digitalRead(25);
  //static bool alt_n = neu_n;
  //if (neu_n && !alt_n && !einmal_n) {
    //vorhin_n = jetzt_n;
    //einmal_n = true;
    //Keyboard.press('n');
    //delay(100);
    //Keyboard.release('n');
  //}
  //if (einmal_n && (jetzt_n - vorhin_n >= debounce1)) {
    //einmal_n = false;
  //}
  //alt_n = neu_n;
  
  if (digitalRead(25) == LOW)

    {Keyboard.press('n');}
    else
    {Keyboard.release('n');}
  
  
//--------------High Beam Flash----------------
  
  static uint32_t vorhin_j = jetzt_j;
  static bool einmal_j = false;
  bool neu_j = !digitalRead(26);
  static bool alt_j = neu_j;
  if (neu_j && !alt_j && !einmal_j) {
    vorhin_j = jetzt_j;
    einmal_j = true;
    Keyboard.press('j');
    delay(90);
    Keyboard.release('j');
  }
  if (einmal_j && (jetzt_j - vorhin_j >= debounce1)) {
    einmal_j = false;
  }
  alt_j = neu_j;
  
//----------------High Beam--------------------
  
  static uint32_t vorhin_k = jetzt_k;
  static bool einmal_k = false;
  bool neu_k = !digitalRead(27);
  static bool alt_k = neu_k;
  if (neu_k && !alt_k && !einmal_k) {
    vorhin_k = jetzt_k;
    einmal_k = true;
    Keyboard.press('k');
    delay(90);
    Keyboard.release('k');
  }
  if (einmal_k && (jetzt_k - vorhin_k >= debounce1)) {
    einmal_k = false;
  }
  alt_k = neu_k;
  
//----------------------menu----------------------
  
   static uint32_t vorhin_esc = jetzt_esc;
  static bool einmal_esc = false;
  bool neu_esc = !digitalRead(28);
  static bool alt_esc = neu_esc;
  if (neu_esc && !alt_esc && !einmal_esc) {
    vorhin_esc = jetzt_esc;
    einmal_esc = true;
    Keyboard.press(177);
    delay(90);
    Keyboard.release(177);
  }
  if (einmal_esc && (jetzt_esc - vorhin_esc >= debounce1)) {
    einmal_esc = false;
  }
  alt_esc = neu_esc;
   
//---------------- retarder + / - ----------------------

  encoderPinCNow = digitalRead(encoderPinC);
  if ((encoderPinCLast == HIGH) && (encoderPinCNow == LOW)) {
    if (digitalRead(encoderPinD) == HIGH) {
      //encoderPos++;
      Keyboard.press(59);
      delay(120);
      Keyboard.release(59);
    } else {
      //encoderPos--;
      Keyboard.press(91);
      delay(120);
      Keyboard.release(91);
      
    }
  }
  encoderPinCLast = encoderPinCNow;
    
//------------------light switch--------------------

  if (xx == 0) {
  static uint32_t vorhin_l0 = jetzt_l0;
  static bool einmal_l0 = false;
  bool neu_l0 = !digitalRead(30);
  static bool alt_l0 = neu_l0;
  if (neu_l0 && !alt_l0 && !einmal_l0) {
    vorhin_l0 = jetzt_l0;
    einmal_l0 = true;
    Keyboard.press('l');
    delay(90);
    Keyboard.release('l');
   
  }
  if (einmal_l0 && (jetzt_l0 - vorhin_l0 >= debounce1)) {
    einmal_l0 = false;
  }
  alt_l0 = neu_l0;}

  if (xx == 2) {
  static uint32_t vorhin_l0 = jetzt_l0;
  static bool einmal_l0 = false;
  bool neu_l0 = !digitalRead(30);
  static bool alt_l0 = neu_l0;
  if (neu_l0 && !alt_l0 && !einmal_l0) {
    vorhin_l0 = jetzt_l0;
    einmal_l0 = true;
    Keyboard.press('l');
    delay(70);
    Keyboard.release('l');
    xx = 0;
  }
    if (einmal_l0 && (jetzt_l0 - vorhin_l0 >= debounce1)) {
    einmal_l0 = false;
  }
  alt_l0 = neu_l0;
  }
  

  if (xx == 0){
  static uint32_t vorhin_l1 = jetzt_l1;
  static bool einmal_l1 = false;
  bool neu_l1 = (digitalRead(30) == HIGH && digitalRead(31) == HIGH);
  static bool alt_l1 = neu_l1;
  if (neu_l1 && !alt_l1 && !einmal_l1) {
    vorhin_l1 = jetzt_l1;
    einmal_l1 = true;
    Keyboard.press('l');
    delay(90);
    Keyboard.release('l');
  }
      if (einmal_l1 && (jetzt_l1 - vorhin_l1 >= debounce1)) {
    einmal_l1 = false;
  }
  alt_l1 = neu_l1;}
  
  if (xx == 2) {
  static uint32_t vorhin_l1 = jetzt_l1;
  static bool einmal_l1 = false;
  bool neu_l1 = (digitalRead(30) == HIGH && digitalRead(31) == HIGH);
  static bool alt_l1 = neu_l1;
  if (neu_l1 && !alt_l1 && !einmal_l1) {
    vorhin_l1 = jetzt_l1;
    einmal_l1 = true;
    Keyboard.press('l');
    delay(70);
    Keyboard.release('l');
    delay(70);
    Keyboard.press('l');
    delay(70);
    Keyboard.release('l');
   
  }
    if (einmal_l1 && (jetzt_l1 - vorhin_l1 >= debounce1)) {
    einmal_l1 = false;
  }
  alt_l1 = neu_l1;}

  static uint32_t vorhin_l2 = jetzt_l2;
  static bool einmal_l2 = false;
  bool neu_l2 = !digitalRead(31);
  static bool alt_l2 = neu_l2;
  if (neu_l2 && !alt_l2 && !einmal_l2) {
    vorhin_l2 = jetzt_l2;
    einmal_l2 = true;
    Keyboard.press('l');
    delay(90);
    Keyboard.release('l');
    xx = 2;
  }
  if (einmal_l2 && (jetzt_l2 - vorhin_l2 >= debounce1)) {
    einmal_l2 = false;
  }
  alt_l2 = neu_l2;
  
  
//-----------------pause----------------------
  
  static uint32_t vorhin_F1 = jetzt_F1;
  static bool einmal_F1 = false;
  bool neu_F1 = !digitalRead(29);
  static bool alt_F1 = neu_F1;
  if (neu_F1 && !alt_F1 && !einmal_F1) {
    vorhin_F1 = jetzt_F1;
    einmal_F1  = true;
    Keyboard.press(194);
    delay(90);
    Keyboard.release(194);
  }
  if (einmal_F1 && (jetzt_F1 - vorhin_F1 >= debounce1)) {
    einmal_F1 = false;
  }
  alt_F1 = neu_F1;
  
  
//----------------look right----------------

   static uint32_t vorhin_F10 = jetzt_F10;
  static bool einmal_F10 = false;
  bool neu_F10 = !digitalRead(22);
  static bool alt_F10 = neu_F10;
  if (neu_F10 && !alt_F10 && !einmal_F10) {
    vorhin_F10 = jetzt_F10;
    einmal_F10  = true;
    Keyboard.press(203);
    delay(90);
    Keyboard.release(203);
  }
  if (einmal_F10 && (jetzt_F10 - vorhin_F10 >= debounce1)) {
    einmal_F10 = false;
  }
  alt_F10 = neu_F10;
  
//----------------look left---------------------

  static uint32_t vorhin_F9 = jetzt_F9;
  static bool einmal_F9 = false;
  bool neu_F9 = !digitalRead(24);
  static bool alt_F9 = neu_F9;
  if (neu_F9 && !alt_F9 && !einmal_F9) {
    vorhin_F9 = jetzt_F9;
    einmal_F9  = true;
    Keyboard.press(202);
    delay(90);
    Keyboard.release(202);
  }
  if (einmal_F9 && (jetzt_F9 - vorhin_F9 >= debounce1)) {
    einmal_F9 = false;
  }
  alt_F9 = neu_F9;
  
//----------------look center---------------------

  static uint32_t vorhin_lc = jetzt_lc;
  static bool einmal_lc = false;
  bool neu_lc = !digitalRead(23);
  static bool alt_lc = neu_lc;
  if (neu_lc && !alt_lc && !einmal_lc) {
    vorhin_lc = jetzt_lc;
    einmal_lc  = true;
    Keyboard.press('1');
    delay(90);
    Keyboard.release('1');
  }
  if (einmal_lc && (jetzt_lc - vorhin_lc >= debounce1)) {
    einmal_lc = false;
  }
  alt_lc = neu_lc;
   
//---------------fuel fill--------------
  
  if (digitalRead(33) == LOW)

    {Keyboard.press(176);}
    else
    {Keyboard.release(176);}
   
//-------------bordcomputer--------------
  
  static uint32_t vorhin_i = jetzt_i;
  static bool einmal_i = false;
  bool neu_i = !digitalRead(32);
  static bool alt_i = neu_i;
  if (neu_i && !alt_i && !einmal_i) {
    vorhin_i = jetzt_i;
    einmal_i  = true;
    Keyboard.press('i');
    delay(90);
    Keyboard.release('i');
  }
  if (einmal_i && (jetzt_i - vorhin_i >= debounce1)) {
    einmal_i = false;
  }
  alt_i = neu_i;
  
  
//-------------blue button--------------
  
  static uint32_t vorhin_bb = jetzt_bb;
  static bool einmal_bb = false;
  bool neu_bb = !digitalRead(40);
  static bool alt_bb = neu_bb;
  if (neu_bb && !alt_bb && !einmal_bb) {
    vorhin_bb = jetzt_bb;
    einmal_bb  = true;
    Keyboard.press(214);
    delay(90);
    Keyboard.release(214);
  }
  if (einmal_bb && (jetzt_bb - vorhin_bb >= debounce1)) {
    einmal_bb = false;
  }
  alt_bb = neu_bb;
  
//-------------green button--------------
  
  static uint32_t vorhin_gb = jetzt_gb;
  static bool einmal_gb = false;
  bool neu_gb = !digitalRead(42);
  static bool alt_gb = neu_gb;
  if (neu_gb && !alt_gb && !einmal_gb) {
    vorhin_gb = jetzt_gb;
    einmal_gb  = true;
    Keyboard.press(211);
    delay(90);
    Keyboard.release(211);
  }
  if (einmal_gb && (jetzt_gb - vorhin_gb >= debounce1)) {
    einmal_gb = false;
  }
  alt_gb = neu_gb;
    
//-----radio select -----
  
  encoderPinENow = digitalRead(encoderPinE);
  if ((encoderPinELast == HIGH) && (encoderPinENow == LOW)) {
    if (digitalRead(encoderPinF) == HIGH) {
      //encoderPos++;
      Keyboard.press(210);
      delay(200);
      Keyboard.release(210);
    } else {
      //encoderPos--;
      Keyboard.press(213);
      delay(200);
      Keyboard.release(213);
      
    }
  }
  encoderPinELast = encoderPinENow;
    
//---------volume radio---------

   pot1_wert = analogRead(pot1); 
   pot1_wert = map(pot1_wert, 0, 1023, 35, 0); 
   lcd.setCursor(3, 1);
   lcd.print(pot1_wert);
   delay(30);
   lcd.setCursor(1, 1);
   lcd.print("      ");
   if (pot1_wert > oldpot1_wert) {
     Keyboard.press(223);
     delay(80);
     Keyboard.release(223);
   }
   if (pot1_wert < oldpot1_wert) {
     Keyboard.press(222);
     delay(80);
     Keyboard.release(222);
   }
   oldpot1_wert = pot1_wert;
      
//-------------black button--------------
   
  static uint32_t vorhin_blk = jetzt_blk;
  static bool einmal_blk = false;
  bool neu_blk = !digitalRead(39);
  static bool alt_blk = neu_blk;
  if (neu_blk && !alt_blk && !einmal_blk) {
    vorhin_blk = jetzt_blk;
    einmal_blk  = true;
    Keyboard.press(234);
    delay(90);
    Keyboard.release(234);
  }
  if (einmal_blk && (jetzt_blk - vorhin_blk >= debounce1)) {
    einmal_blk = false;
  }
  alt_blk = neu_blk;
    
//-------------red button--------------
   
  static uint32_t vorhin_rb = jetzt_rb;
  static bool einmal_rb = false;
  bool neu_rb = !digitalRead(43);
  static bool alt_rb = neu_rb;
  if (neu_rb && !alt_rb && !einmal_rb) {
    vorhin_rb = jetzt_rb;
    einmal_rb  = true;
    Keyboard.press(235);
    delay(90);
    Keyboard.release(235);
  }
  if (einmal_rb && (jetzt_rb - vorhin_rb >= debounce1)) {
    einmal_rb = false;
  }
  alt_rb = neu_rb;
    
//-------------yellow button--------------
   
  static uint32_t vorhin_yb = jetzt_yb;
  static bool einmal_yb = false;
  bool neu_yb = !digitalRead(38);
  static bool alt_yb = neu_yb;
  if (neu_yb && !alt_yb && !einmal_yb) {
    vorhin_yb = jetzt_yb;
    einmal_yb  = true;
    Keyboard.press(204);
    delay(90);
    Keyboard.release(204);
  }
  if (einmal_yb && (jetzt_yb - vorhin_yb >= debounce1)) {
    einmal_yb = false;
  }
  alt_yb = neu_yb;
}

